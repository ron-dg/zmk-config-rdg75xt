## config/boards/arm/rdg75xt/Kconfig.defconfig
```kconfig
# RDG75XT board configuration

# Copyright (c) 2020 The ZMK Contributors
# SPDX-License-Identifier: MIT

if BOARD_RDG75XT

config ZMK_KEYBOARD_NAME
	default "RDG75XT"

if USB

config USB_NRFX
	default y

config USB_DEVICE_STACK
	default y

endif # USB

config BT_CTLR
	default BT

config ZMK_BLE
	default y

config ZMK_USB
	default y

config ZMK_BATTERY_VOLTAGE_DIVIDER
	default y

config SPI
    default y

config ZMK_DISPLAY
	select LVGL_FONT_MONTSERRAT_26

if ZMK_DISPLAY

config LS0XX
	default y

config LVGL_BITS_PER_PIXEL
	default 1

choice LVGL_COLOR_DEPTH
	default LVGL_COLOR_DEPTH_1
endchoice

endif # ZMK_DISPLAY

endif # BOARD_RDG75XT
```

## config/boards/arm/rdg75xt/Kconfig.txt
```kconfig
# RDG75XT board configuration

# Copyright (c) 2020 The ZMK Contributors
# SPDX-License-Identifier: MIT

config BOARD_RDG75XT
	bool "RDG75XT"
	depends on SOC_NRF52840_QIAA
```

## config/boards/arm/rdg75xt/rdg75xt_defconfig
```kconfig
# SPDX-License-Identifier: MIT

CONFIG_SOC_SERIES_NRF52X=y
CONFIG_SOC_NRF52840_QIAA=y
CONFIG_BOARD_RDG75XT=y

# Enable MPU
CONFIG_ARM_MPU=y

# enable GPIO
CONFIG_GPIO=y

CONFIG_USE_DT_CODE_PARTITION=y

CONFIG_MPU_ALLOW_FLASH_WRITE=y
CONFIG_NVS=y
CONFIG_SETTINGS_NVS=y
CONFIG_FLASH=y
CONFIG_FLASH_PAGE_LAYOUT=y
CONFIG_FLASH_MAP=y

# Enable the rotary encoder
CONFIG_EC11=y
CONFIG_EC11_TRIGGER_GLOBAL_THREAD=y

# Enable the nice!view
CONFIG_ZMK_DISPLAY=y
CONFIG_LVGL_THEME_DEFAULT_FONT_SMALL_MONTSERRAT_26=y
CONFIG_LVGL_THEME_DEFAULT_FONT_NORMAL_MONTSERRAT_26=y
CONFIG_ZMK_DISPLAY_BLANK_ON_IDLE=n

# nice!view features
CONFIG_ZMK_WIDGET_WPM_STATUS=y

CONFIG_BUILD_OUTPUT_UF2=y
```
